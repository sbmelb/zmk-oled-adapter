## boards/shields/oled_adapter/Kconfig.defconfig
```kconfig
# Copyright (c) 2022 The ZMK Contributors
# SPDX-License-Identifier: MIT

if SHIELD_OLED_ADAPTER_PRO_MICRO_128X32 || SHIELD_OLED_ADAPTER_PRO_MICRO_128X64_SOLOMON || SHIELD_OLED_ADAPTER_PRO_MICRO_128X64_SINOWEALTH|| SHIELD_OLED_ADAPTER_PRO_MICRO_128X128 || SHIELD_OLED_ADAPTER_SEEEDUINO_XIAO_BLE_128X32 || SHIELD_OLED_ADAPTER_SEEEDUINO_XIAO_BLE_128X64 || SHIELD_OLED_ADAPTER_SEEEDUINO_XIAO_BLE_128X128

if ZMK_DISPLAY

config I2C
    default y

endif    

if SHIELD_OLED_ADAPTER_PRO_MICRO_128X64_SOLOMON || SHIELD_OLED_ADAPTER_PRO_MICRO_128X32
if ZMK_DISPLAY
config SSD1306
    default y
endif
endif

if SHIELD_OLED_ADAPTER_PRO_MICRO_128X64_SINOWEALTH
if ZMK_DISPLAY
config SH1106
    bool
    default y
endif
endif
```

## dts/bindings/display/sinowealth/sh1106-i2c.yaml
```yaml
description: Sinowealth SH1106 OLED controller over I2C

compatible: "sinowealth,sh1106-i2c"

include:
  - name: i2c-device.yaml

properties:
  width:
    type: int
    required: true
  height:
    type: int
    required: true

  segment-offset:
    type: int
  page-offset:
    type: int
  display-offset:
    type: int
  multiplex-ratio:
    type: int
  segment-remap:
    type: boolean
  com-invdir:
    type: boolean
  inversion-on:
    type: boolean
  prechargep:
    type: int
```
